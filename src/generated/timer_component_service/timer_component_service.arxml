AUTOSAR XML (schema 00051)
package /TimerComponentServiceManifest
  4 x std cpp implementation data type:
    uint32_t: category=VALUE
      namespaces:
        symbol props std
    bool: category=VALUE
    uint32: type-reference=uint32_t  # Generated from Classic ImplementationDataType /AUTOSAR_Platform/ImplementationDataTypes/uint32
      namespaces:
        symbol props generated
        symbol props timercomponentservice
    boolean: type-reference=bool  # Generated from Classic ImplementationDataType /AUTOSAR_Platform/ImplementationDataTypes/boolean
      namespaces:
        symbol props generated
        symbol props timercomponentservice
  service interface TimerComponentService  # Generated from Classic SWC /ComponentTypes/TimerComponent by autosar classic-to-adaptive bridge v0 (AE-29 prototype). PROTOTYPE OUTPUT - not a certified toolchain, not for production or safety use.
    namespaces:
      symbol props generated
      symbol props timercomponentservice
    methods:
      operation GetTime  # Generated from port /ComponentTypes/TimerComponent/FreeRunningTimer, operation /PortInterfaces/FreeRunningTimer_I/GetTime
        arg value: type=uint32, direction=OUT
      operation IsTimerElapsed  # Generated from port /ComponentTypes/TimerComponent/FreeRunningTimer, operation /PortInterfaces/FreeRunningTimer_I/IsTimerElapsed
        arg startTime: type=uint32, direction=IN
        arg duration: type=uint32, direction=IN
        arg result: type=boolean, direction=OUT
  someip service interface deployment TimerComponentService_SomeIp: service-interface=TimerComponentService, service-interface-id=4097, service-interface-version={major-version=1, minor-version=0}
    someip method deployment GetTime: method=GetTime, method-id=1, transport-protocol=TCP
    someip method deployment IsTimerElapsed: method=IsTimerElapsed, method-id=2, transport-protocol=TCP
