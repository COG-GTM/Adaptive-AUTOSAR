AUTOSAR XML (schema 00051)
package /WheelSpeedSensorServiceManifest
  std cpp implementation data type uint16_t: category=VALUE
    namespaces:
      symbol props std
  std cpp implementation data type WheelSpeed_T: type-reference=uint16_t  # Generated from Classic ImplementationDataType /DataTypes/ImplementationDataTypes/WheelSpeed_T
    namespaces:
      symbol props generated
      symbol props wheelspeedsensorservice
  service interface WheelSpeedSensorService  # Generated from Classic SWC /ComponentTypes/WheelSpeedSensor by autosar classic-to-adaptive bridge v0 (AE-29 prototype). PROTOTYPE OUTPUT - not a certified toolchain, not for production or safety use.
    namespaces:
      symbol props generated
      symbol props wheelspeedsensorservice
    events:
      data WheelSpeed: type=WheelSpeed_T  # Generated from port /ComponentTypes/WheelSpeedSensor/WheelSpeed, data element /PortInterfaces/WheelSpeed_I/WheelSpeed
  someip service interface deployment WheelSpeedSensorService_SomeIp: service-interface=WheelSpeedSensorService, service-interface-id=4096, service-interface-version={major-version=1, minor-version=0}
    someip event deployment WheelSpeed: event=WheelSpeed, event-id=32769, transport-protocol=UDP
    someip event group AllEvents: event-group-id=1, event=WheelSpeed
